## Kconfig
```kconfig
#
# Copyright (c) 2022 Laird Connectivity LLC
#
# SPDX-License-Identifier: LicenseRef-LairdConnectivity-Clause
#
menuconfig LCZ_BLE_GW_DM
	bool "LC BLE Gateway Device Manager"
	depends on LCZ_NETWORK_MONITOR
	depends on FRAMEWORK
	depends on LCZ_LWM2M_CLIENT
	depends on LCZ_SOFTWARE_RESET
	depends on DATE_TIME

if LCZ_BLE_GW_DM

module=LCZ_BLE_GW_DM
module-str=LCZ_BLE_GW_DM
source "subsys/logging/Kconfig.template.log_config"

config LCZ_BLE_GW_DM_THREAD_PRIORITY
	int "Preemptible thread priority"
	range 0 NUM_PREEMPT_PRIORITIES
	default 0

config LCZ_BLE_GW_DM_THREAD_STACK_SIZE
	int "Stack size"
	default 2048

config LCZ_BLE_GW_DM_CLIENT_INDEX
    int "Client index for DM LwM2M connection"
	default 0

config LCZ_BLE_GW_DM_CONNECTION_TIMEOUT
	int "DM connection timeout"
	default 60
	help
	  Time in seconds to wait for connection timeout before restarting
	  the connection sequence.

config LCZ_BLE_GW_DM_WAIT_FOR_NETWORK_TIMEOUT
	int "Wait for network timeout"
	default 60
	help
	  Time in seconds to wait for the network to be ready before forcing
	  a re-check.

config LCZ_BLE_GW_DM_TELEM_LWM2M
	bool "LwM2M Telemetry"
	help
	  Enable a second LwM2M connection for telemetry data.

if LCZ_BLE_GW_DM_TELEM_LWM2M

config LCZ_BLE_GW_DM_TELEMETRY_INDEX
    int "LwM2M telemetry connection index"
	default 1

config LCZ_BLE_GW_DM_TELEMETRY_SERVER_INST
    int "LwM2M telemetry server inst"
	default 2
	help
	  Instance value for object 0 that is associated with the telemetry
	  connection.

config LCZ_BLE_GW_DM_TELEM_LWM2M_TLS_TAG
	int "TLS tag for secure connection"
	depends on LCZ_LWM2M_DTLS_SUPPORT
	default 1000
	range 0 65535

endif # LCZ_BLE_GW_DM_TELEM_LWM2M

choice
	prompt "Init mode"
	default LCZ_BLE_GW_DM_INIT_KCONFIG

config LCZ_BLE_GW_DM_INIT_KCONFIG
	bool "Kconfig"
	help
	  Use Kconfig settings to init service.

config LCZ_BLE_GW_DM_INIT_ATTRIBUTES
	bool "Attributes"
	depends on ATTR
	select LCZ_BLE_GW_DM_ENABLE_ATTRIBUTES
	help
	  Use attributes system to init service.

endchoice

config LCZ_BLE_GW_DM_ENABLE_ATTRIBUTES
	bool "Enable attributes"
	depends on ATTR
	help
	  Enable attributes system for settings.

if LCZ_BLE_GW_DM_INIT_KCONFIG

config LCZ_BLE_GW_DM_CONNECTION_DELAY
	int "DM connection delay"
	default 5
	help
	  Time in seconds to delay before connecting to device management
	  services after the network connection is ready.

if LCZ_BLE_GW_DM_TELEM_LWM2M

config LCZ_BLE_GW_DM_TELEM_LWM2M_SERVER_URL
	string "Server URL"
	default "coap://leshan.eclipseprojects.io:5683"

config LCZ_BLE_GW_DM_TELEM_LWM2M_ENDPOINT_NAME
	string "Endpoint name"
	default "endpoint"
	help
	  Endpoint name used by the application for starting a connection.

config LCZ_BLE_GW_DM_TELEM_LWM2M_SECURITY_MODE
	int "Security mode"
	range 0 4
	default 3
	help
	  0 - PSK
	  1 - RPK
	  2 - Certificate
	  3 - No Security
	  4 - Certificate with EST

config LCZ_BLE_GW_DM_TELEM_LWM2M_PSK_ID
	string "PSK ID"
	default "my_psk"
	help
	  Pre-shared key identity

config LCZ_BLE_GW_DM_TELEM_LWM2M_PSK
	string "PSK"
	default "000102030405060708090a0b0c0d0e0f"
	help
	  PSK as a HEX string. This string will be converted to binary and
	  used as the PSK.
	  Length of this string needs to be LCZ_LWM2M_SECURITY_KEY_SIZE.

config LCZ_BLE_GW_DM_TELEM_LWM2M_SHORT_SERVER_ID
	int "Short server ID"
	range 1 65534
	default 2

endif # LCZ_BLE_GW_DM_TELEM_LWM2M

endif # LCZ_BLE_GW_DM_INIT_KCONFIG

menuconfig LCZ_BLE_GW_DM_MEMFAULT
	bool "Memfault data reporting"
	depends on LCZ_MEMFAULT
	depends on FILE_SYSTEM_UTILITIES

if LCZ_BLE_GW_DM_MEMFAULT

config LCZ_BLE_GW_DM_MEMFAULT_THREAD_PRIORITY
	int "Preemptible thread priority"
	range 0 NUM_PREEMPT_PRIORITIES
	default 0

config LCZ_BLE_GW_DM_MEMFAULT_THREAD_STACK_SIZE
	int "Stack size"
	default 3072

config LCZ_BLE_GW_DM_MEMFAULT_REPORT_PERIOD_SECONDS
	int "Report period"
	default 3600
	help
	  How often to periodically push memfault data (in seconds)

config LCZ_BLE_GW_DM_MEMFAULT_CHUNK_BUF_SIZE
	int "Chunk buffer size"
	default 2048
	help
	  Size of the buffer used to post/save memfault data

config LCZ_BLE_GW_DM_MEMFAULT_FILE_NAME
	string "Memfault data file name"
	default "mflt.bin"
	help
	  File name where Memfault data will be saved

config LCZ_BLE_GW_DM_MEMFAULT_FILE_MAX_SIZE_BYTES
	int "Memfault data file max size"
	default 512000
	help
	  If the file grows past this size it will be deleted and re-created

endif # LCZ_BLE_GW_DM_MEMFAULT

if MODEM_HL7800

config LCZ_BLE_GW_DM_HL7800_INIT_PRIORITY
    int "Application init priority for hl7800"
    range 0 99
    default APPLICATION_INIT_PRIORITY

endif # MODEM_HL7800

if BT
config LCZ_BLE_GW_DM_BLE_ADDR_INIT_PRIORITY
    int "BLE address init priority"
    range 0 99
    default APPLICATION_INIT_PRIORITY
    help
      Application init priority for BLE address
endif # BT

endif # LCZ_BLE_GW_DM
```
